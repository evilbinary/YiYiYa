## image/kernel-orangepi-pc.its
```
/*
 * Simple U-Boot uImage source file containing a single kernel
 */

/dts-v1/;

/ {
	description = "Simple image with single duck kernel";
	#address-cells = <1>;

	images {
		setup {
			description = "YiYiYa init";
			data = /incbin/("../boot/arm/init.bin");
			type = "kernel";
			arch = "arm";
			os = "linux";
			compression = "none";
			load = <0x00000>;
			entry = <0x00000>;
			hash-2 {
				algo = "sha1";
			};
		};
		kernel {
			description = "YiYiYa kernel";
			data = /incbin/("../duck/init/kernel.elf");
			type = "ramdisk";
			arch = "arm";
			os = "linux";
			compression = "none";
			load  = <0x40000000>;
			entry = <0x40000000>;
			hash-1 {
				algo = "crc32";
			};
			hash-2 {
				algo = "sha1";
			};
		};
		
	};

	configurations {
		default = "config-1";
		config-1 {
			description = "YiYiYa init";
			kernel = "setup";
			ramdisk="kernel";
		};
		 config-2 {
			description = "YiYiYa kernel";
			kernel = "kernel";
    	};
	};
	
};
```

## image/kernel.its
```
/*
 * Simple U-Boot uImage source file containing a single kernel
 */

/dts-v1/;

/ {
	description = "Simple image with single duck kernel";
	#address-cells = <1>;

	images {
		kernel {
			description = "duck kernel";
			data = /incbin/("../kernel/kernel");
			type = "kernel";
			arch = "x86";
			os = "linux";
			compression = "none";
			load = <000000000>;
			entry = <000000000>;
			hash-1 {
				algo = "crc32";
			};
			hash-2 {
				algo = "sha1";
			};
		};
		setup {
			description = "duck init";
			data = /incbin/("../boot/x86/init");
			type = "x86_setup";
			arch = "x86";
			os = "linux";
			compression = "none";
			load = <0x000500>;
			entry = <0x000500>;
			hash-2 {
				algo = "sha1";
			};
		};
	};

	configurations {
		default = "config-1";
		config-1 {
			description = "Boot duck kernel";
			kernel = "kernel";
			setup = "setup";
		};
	};
};
```
